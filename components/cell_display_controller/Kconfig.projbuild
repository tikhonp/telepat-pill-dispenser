## components/cell_display_controller/Kconfig.projbuild
```kconfig
menu "Leds display settings"
    choice CDC_LEDS_TYPE
        prompt "Type of hardware for leds controller"
        default CDC_LEDS_PLAIN_PINS

        config CDC_LEDS_PLAIN_PINS
            bool "Plain Pins"
        config CDC_LEDS_MATRIX
            bool "Matrix"
        config CDC_LEDS_WS2812B
            bool "WS2812b Addressable LEDs"
    endchoice

    config EXAMPLE_I2C_MASTER_SCL
        int "SCL GPIO Number"
        default 5 if IDF_TARGET_ESP8266
        default 6 if IDF_TARGET_ESP32C2 || IDF_TARGET_ESP32C3 || IDF_TARGET_ESP32C5 || IDF_TARGET_ESP32C6 || IDF_TARGET_ESP32C61
        default 19 if IDF_TARGET_ESP32 || IDF_TARGET_ESP32S2 || IDF_TARGET_ESP32S3
        default 4 if IDF_TARGET_ESP32H2
        default 4 if IDF_TARGET_ESP32P4
        help
            GPIO number for I2C Master clock line.

    config EXAMPLE_I2C_MASTER_SDA
        int "SDA GPIO Number"
        default 4 if IDF_TARGET_ESP8266
        default 5 if IDF_TARGET_ESP32C2 || IDF_TARGET_ESP32C3 || IDF_TARGET_ESP32C5 || IDF_TARGET_ESP32C6 || IDF_TARGET_ESP32C61
        default 18 if IDF_TARGET_ESP32 || IDF_TARGET_ESP32S2 || IDF_TARGET_ESP32S3
        default 3 if IDF_TARGET_ESP32H2
        default 3 if IDF_TARGET_ESP32P4
        help
            GPIO number for I2C Master data line.
    
    config EXAMPLE_I2C_FREQUENCY_HZ
        int "I2C bus frequency"
        default 400000
        help
            I2C bus frequency.
    
    config WS2812B_GPIO
        int "WS2812B data GPIO"
        depends on CDC_LEDS_WS2812B
        default 18
        help
            GPIO pin used to drive WS2812B data line.

    config WS2812B_LED_COUNT
        int "Number of WS2812B LEDs"
        depends on CDC_LEDS_WS2812B
        default 28
        help
            Number of addressable WS2812B LEDs in the strip.
endmenu
```

## components/display_error/Kconfig.projbuild
```kconfig
menu "Reset config"
    config RESET_BUTTON_PIN
        int "Reset button pin"
        default 2
        help
            Reset button pin
    config RESET_HOLD_TIME_MS
        int "Reset button hold time (ms)"
        default 5000
        help
            How many milliseconds button must be held on boot to trigger reset
endmenu
```

## components/medsenger_http_requests/Kconfig.projbuild
```kconfig
menu "Medsenger HTTP requests"
    config HTTP_ENDPOINT
        string "HTTP Endpoint"
        default "pills.ai.medsenger.ru"
        help
            Target endpoint for pill dispenser backend

    config FETCH_SCHEDULE_QUERY_PATH
        string "Fetch schedule query"
        default "/pill-dispenser/schedule"
        help
            Query path for fetch schedule endpoint

    config SUBMIT_SUCCESS_QUERY_PATH
        string "Submit success query"
        default "/pill-dispenser/submit"
        help
            Submit success pill for specific cell query path
    
    config REQUEST_RETRY_COUNT
        int "Request retry count"
        default 3
        help
            Number of HTTP-request retries
endmenu
```

## components/pilld_models/Kconfig.projbuild
```kconfig
menu "Cell Data"
    config SD_CELLS_COUNT
        int "Cells count"
        default 4
        help
            Count of meds cells in current device

    config SD_BUZZER_PIN_NUMBER
        int "Pin Number for Buzzer"
        default 5
        help
            Pin number for Buzzer
endmenu
```

## components/wifi_manager/Kconfig.projbuild
```kconfig
menu "Wi-Fi connection configuration"
    config WM_SNTP_TIME_SERVER
        string "SNTP server name"
        default "pool.ntp.org"
        help
            Hostname of the main SNTP server.

    config WM_CAPTIVE_PORTAL_NETWORK_NAME
        string "Captive portal network name"
        default "pill-dispenser"

    config WM_WIFI_CONN_MAX_RETRY
        int "Maximum retry"
        default 6
        help
            Set the Maximum retry to avoid station reconnecting to the AP unlimited when the AP is really inexistent.

    choice WM_WIFI_SCAN_METHOD
        prompt "WiFi Scan Method"
        default WM_WIFI_SCAN_METHOD_FAST
        help
            WiFi scan method:

            If "Fast" is selected, scan will end after find SSID match AP.

            If "All Channel" is selected, scan will end after scan all the channel.

        config WM_WIFI_SCAN_METHOD_FAST
            bool "Fast"
        config WM_WIFI_SCAN_METHOD_ALL_CHANNEL
            bool "All Channel"
    endchoice

    menu "WiFi Scan threshold"
        config WM_WIFI_SCAN_RSSI_THRESHOLD
            int "WiFi minimum rssi"
            range -127 0

            default -127
            help
                The minimum rssi to accept in the scan mode.

        choice WM_WIFI_SCAN_AUTH_MODE_THRESHOLD
            prompt "WiFi Scan auth mode threshold"
            default WM_WIFI_AUTH_WEP
            help
                The weakest authmode to accept in the scan mode.

            config WM_WIFI_AUTH_OPEN
                bool "OPEN"
            config WM_WIFI_AUTH_WEP
                bool "WEP"
            config WM_WIFI_AUTH_WPA_PSK
                bool "WPA PSK"
            config WM_WIFI_AUTH_WPA2_PSK
                bool "WPA2 PSK"
            config WM_WIFI_AUTH_WPA_WPA2_PSK
                bool "WPA WPA2 PSK"
            config WM_WIFI_AUTH_WPA2_ENTERPRISE
                bool "WPA2 ENTERPRISE"
            config WM_WIFI_AUTH_WPA3_PSK
                bool "WPA3 PSK"
            config WM_WIFI_AUTH_WPA2_WPA3_PSK
                bool "WPA2 WPA3 PSK"
            config WM_WIFI_AUTH_WAPI_PSK
                bool "WAPI PSK"
        endchoice
    endmenu

    choice WM_WIFI_CONNECT_AP_SORT_METHOD
        prompt "WiFi Connect AP Sort Method"
        default WM_WIFI_CONNECT_AP_BY_SIGNAL
        help
            WiFi connect AP sort method:

            If "Signal" is selected, Sort matched APs in scan list by RSSI.

            If "Security" is selected, Sort matched APs in scan list by security mode.

        config WM_WIFI_CONNECT_AP_BY_SIGNAL
            bool "Signal"
        config WM_WIFI_CONNECT_AP_BY_SECURITY
            bool "Security"
    endchoice
endmenu
```

## main/Kconfig.projbuild
```kconfig
menu "PILL DISPENSER config"
    config SERIAL_NUMBER
        string "Serial number"
        default UNKNOWN
        help
            Serial number of device for identification

    choice HW_TYPE
        prompt "Hardware type"
        default HW_2X2_V1
        help
            Select hardware type of your pill dispenser

        config HW_2X2_V1
            bool "2x2 v1"
        config HW_4X7_V1
            bool "4x7 v1"
    endchoice

    menu "GPIO config"
        config WS2812B_ENABLE_GPIO
            int "WS2812B enable GPIO"
            default 4
            help
                GPIO pin used to enable/disable power line for light strip.

        config WS2812B_CONTROL_GPIO
            int "WS2812B data GPIO"
            default 8
            help
                GPIO pin used to drive WS2812B data line.

        config RESET_BUTTON_PIN
            int "Reset button pin"
            default 2
            help
                Reset button pin

        config BUZZER_PIN_NUMBER
            int "Pin Number for Buzzer"
            default 5
            help
                Pin number for Buzzer
    endmenu

    config RESET_HOLD_TIME_MS
        int "Reset button hold time (ms)"
        default 5000
        help
            How many milliseconds button must be held on boot to trigger reset

    config BATTERY_VOLTAGE_DIVIDER_RATIO
        int "Battery voltage divider ratio (scaled by 10)"
        default 13
        help
            Voltage divider ratio used to measure battery voltage
endmenu
```
